## arch/arm/soc/atmel_sam4/Kconfig.defconfig
```kconfig
# Kconfig - Atmel SAM4 family processor configuration options
#
# Copyright (c) 2017 Justin Watson
# SPDX-License-Identifier: Apache-2.0
#

if SOC_ATMEL_SAM4

config SOC
	default atmel_sam4

config NUM_IRQ_PRIO_BITS
	int
	default 4

#
# SAM4S16 has total 35 peripherals capable of
# generating interrupts.
#
config NUM_IRQS
	int
	default 35

config SYS_CLOCK_HW_CYCLES_PER_SEC
	int
	default 84000000

#
# SRAM address depends on the processor.
#
# SAM4S16 has 1 SRAM bank:
#   1024K @ 0x20100000
#
# Table 8-1 of datasheet has the SRAM Size
# Figure 7-1 page 38 has the SRAM base address
#
config SRAM_SIZE
	int
	default 128 if SOC_ATMEL_SAM4S16

config SRAM_BASE_ADDRESS
	hex
	default 0x20100000 if SOC_ATMEL_SAM4S16

#
# Atmel SAM4 family has flash starting @ 0x00400000.
# Flash Sector Organization Figure 8-2, Page 41
#
# SAM4S16 has 1024K of flash.
#
config FLASH_SIZE
	int
	default 1024 if SOC_ATMEL_SAM4S16

config FLASH_BASE_ADDRESS
	hex
	default 0x00400000

if UART_ATMEL_SAM4

config UART_ATMEL_SAM4_BAUD_RATE
	int
	default 115200

config UART_ATMEL_SAM4_CLK_FREQ
	int
	default 84000000
	help
	This is the clock that the UART receives. Not the baudrate.

endif # UART_ATMEL_SAM4

if GPIO

config GPIO_ATMEL_SAM4
	def_bool y

config GPIO_ATMEL_SAM4_PORTA
	bool
	default y

config GPIO_ATMEL_SAM4_PORTB
	bool
	default y

config GPIO_ATMEL_SAM4_PORTC
	bool
	default y

endif # GPIO

endif # SOC_ATMEL_SAM4
```

## arch/arm/soc/atmel_sam4/Kconfig.soc
```kconfig
# Kconfig - Atmel SAM4 MCU series selection
#
# Copyright (c) 2017 Justin Watson
# SPDX-License-Identifier: Apache-2.0
#

config SOC_ATMEL_SAM4S16
	bool "Atmel SAM4S16 Processor"
	select CPU_CORTEX_M
	select CPU_CORTEX_M4
	select SOC_ATMEL_SAM4
	select SYS_POWER_LOW_POWER_STATE_SUPPORTED
	select CPU_HAS_SYSTICK
```

## boards/arm/atmel_sam4s_xpld/Kconfig.board
```kconfig
config BOARD_ATMEL_SAM4S_XPLD
	bool "Atmel SAM4S Xplained"
	depends on SOC_ATMEL_SAM4S16

config ENABLE_EXTERAL_SRAM
	bool "Enable the external SRAM"
	default n
	depends on BOARD_ATMEL_SAM4S_XPLD
	help
	This is for the IS66WV51216DALL chip on the
	SAM4S Xplained Board.
```

## boards/arm/atmel_sam4s_xpld/Kconfig.defconfig
```kconfig
if BOARD_ATMEL_SAM4S_XPLD

config BOARD
	default atmel_sam4s_xpld

endif # BOARD_ATMEL_SAM4S_XPLD
```

## boards/arm/atmel_sam4s_xpld/atmel_sam4s_xpld_defconfig
```kconfig
CONFIG_ARM=y
CONFIG_SOC_ATMEL_SAM4S16=y
CONFIG_BOARD_ATMEL_SAM4S_XPLD=y
CONFIG_CORTEX_M_SYSTICK=y
CONFIG_CONSOLE=y
CONFIG_UART_CONSOLE=y
CONFIG_SERIAL=y
CONFIG_UART_ATMEL_SAM4=y
CONFIG_PINMUX=y
CONFIG_UART_CONSOLE_ON_DEV_NAME="UART_1"
```

## drivers/gpio/Kconfig.atmel_sam4
```kconfig
# Kconfig.atmel_sam4 - Atmel SAM4 GPIO configuration options
#
#
# Copyright (c) 2016 Intel Corporation
#
# Licensed under the Apache License, Version 2.0 (the "License");
# you may not use this file except in compliance with the License.
# You may obtain a copy of the License at
#
#     http://www.apache.org/licenses/LICENSE-2.0
#
# Unless required by applicable law or agreed to in writing, software
# distributed under the License is distributed on an "AS IS" BASIS,
# WITHOUT WARRANTIES OR CONDITIONS OF ANY KIND, either express or implied.
# See the License for the specific language governing permissions and
# limitations under the License.
#

menuconfig GPIO_ATMEL_SAM4
	bool "Atmel SAM4 PIO Controllers"
	depends on GPIO && SOC_ATMEL_SAM4
	default n
	help
	Enable config options to support the PIO controllers
	on Atmel SAM4 family processors.

	Says n if not sure.

if GPIO_ATMEL_SAM4

config GPIO_ATMEL_SAM4_PORTA
	bool "Enable driver for Atmel SAM4 PIO Port A"
	depends on GPIO_ATMEL_SAM4
	default n
	help
	Build the driver to utilize PIO controller Port A.

config GPIO_ATMEL_SAM4_PORTA_DEV_NAME
	string "Device name for Port A"
	depends on GPIO_ATMEL_SAM4_PORTA
	default "PIOA"
	help
	Device name for Port A.

config GPIO_ATMEL_SAM4_PORTA_IRQ_PRI
	int "Interrupt Priority for Port A"
	depends on GPIO_ATMEL_SAM4_PORTA
	default 3
	help
	Interrupt priority for Port A.

config GPIO_ATMEL_SAM4_PORTB
	bool "Enable driver for Atmel SAM4 PIO Port B"
	depends on GPIO_ATMEL_SAM4
	default n
	help
	Build the driver to utilize PIO controller Port B.

config GPIO_ATMEL_SAM4_PORTB_DEV_NAME
	string "Device name for Port B"
	depends on GPIO_ATMEL_SAM4_PORTB
	default "PIOB"
	help
	Device name for Port B.

config GPIO_ATMEL_SAM4_PORTB_IRQ_PRI
	int "Interrupt Priority for Port B"
	depends on GPIO_ATMEL_SAM4_PORTB
	default 3
	help
	Interrupt priority for Port B.

config GPIO_ATMEL_SAM4_PORTC
	bool "Enable driver for Atmel SAM4 PIO Port C"
	depends on GPIO_ATMEL_SAM4
	default n
	help
	Build the driver to utilize PIO controller Port C.

config GPIO_ATMEL_SAM4_PORTC_DEV_NAME
	string "Device name for Port C"
	depends on GPIO_ATMEL_SAM4_PORTC
	default "PIOC"
	help
	Device name for Port C.

config GPIO_ATMEL_SAM4_PORTC_IRQ_PRI
	int "Interrupt Priority for Port C"
	depends on GPIO_ATMEL_SAM4_PORTC
	default 3
	help
	Interrupt priority for Port C.

endif # GPIO_ATMEL_SAM4
```

## drivers/serial/Kconfig.atmel_sam4
```kconfig
menuconfig UART_ATMEL_SAM4
	bool "Atmel SAM4 family processor UART driver"
	default n
	select SERIAL_HAS_DRIVER
	depends on SOC_ATMEL_SAM4
	help
	This option enables the UART driver for Atmel SAM4
	family processors. UART on the SAM4 has only two wires
	for RX and TX, and does not have other pins
	(such as CTS and RTS).

config UART_ATMEL_SAM4_NAME
	string "Device Name for Atmel SAM4 UART"
	default "UART_1"
	depends on UART_ATMEL_SAM4
	help
	  This is the device name for UART, and is included in the device
	  struct.

config UART_ATMEL_SAM4_IRQ_PRI
	int "Atmel SAM4 UART Interrupt Priority"
	default 0
	depends on UART_ATMEL_SAM4
	help
	  The interrupt priority for UART port.

config UART_ATMEL_SAM4_BAUD_RATE
	int "Atmel SAM4 UART Baud Rate"
	default 0
	depends on UART_ATMEL_SAM4
	help
	  The baud rate for UART port to be set to at boot.

config UART_ATMEL_SAM4_CLK_FREQ
	int "Atmel SAM4 UART Clock Frequency"
	default 0
	depends on UART_ATMEL_SAM4
	help
	  The clock frequency for UART port.
```

## drivers/spi/Kconfig.sam
```kconfig
# Kconfig - Atmel SAM SPI
#
# Copyright (c) 2018 Justin Watson
# SPDX-License-Identifier: Apache-2.0

menuconfig SPI_SAM
	bool "Atmel SAM series SPI driver"
	depends on SOC_FAMILY_SAM
	select HAS_DTS_SPI
	default n
	help
	  Enable support for the SAM SPI driver.
```

## dts/bindings/spi/atmel,sam-spi.yaml
```yaml
#
# Copyright (c) 2018 Justin Watson
#
# SPDX-License-Identifier: Apache-2.0
#
---
title: Atmel SAM SPI driver
id: atmel,sam-spi
version: 0.1

description: >
    This binding gives a base representation of the Atmel SAM SPI controller

inherits:
    !include spi.yaml

properties:
    compatible:
      type: string
      category: required
      description: compatible strings
      constraint: "atmel,sam-spi"

    reg:
      type: array
      description: mmio register space
      generation: define
      category: required

    interrupts:
      type: compound
      category: required
      description: required interrupts
      generation: define

    label:
      type: string
      category: required
      description: Human readable string describing the device (used by Zephyr for API name)
      generation: define

    peripheral-id:
      type: int
      description: peripheral ID
      generation: define
      category: required
...
```
